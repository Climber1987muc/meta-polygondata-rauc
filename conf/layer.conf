## conf/layer.conf
```bitbake
# We have a conf and classes directory, add to BBPATH
BBPATH .= ":${LAYERDIR}"

# We have recipes-* directories, add to BBFILES
BBFILES += "${LAYERDIR}/recipes-*/*/*.bb \
            ${LAYERDIR}/recipes-*/*/*.bbappend"

BBFILE_COLLECTIONS += "meta-polygondata-rauc"
BBFILE_PATTERN_meta-polygondata-rauc = "^${LAYERDIR}/"
BBFILE_PRIORITY_meta-polygondata-rauc = "6"

LAYERDEPENDS_meta-polygondata-rauc = "core"
LAYERSERIES_COMPAT_meta-polygondata-rauc = "walnascar"
```
